## app/boards/arm/glove80/Kconfig.defconfig
```kconfig
# Copyright (c) 2021 The ZMK Contributors
# SPDX-License-Identifier: MIT

if BOARD_GLOVE80_LH

config BOARD
    default "glove80 lh"

config ZMK_SPLIT_ROLE_CENTRAL
    default y

config ZMK_SPLIT_ROLE_CENTRAL
    default y

endif # BOARD_GLOVE80_LH

if BOARD_GLOVE80_RH

config BOARD
    default "glove80 rh"

endif # BOARD_GLOVE80_RH

if BOARD_GLOVE80_LH || BOARD_GLOVE80_RH

config ZMK_STUDIO
    default y

config ZMK_GLOVE80_STATUS_ON_BOTH_HALVES
    bool "Show Glove80 status indicators on both halves"
    depends on !ZMK_STUDIO
    default n
    help
      Show local battery, lock, and complementary layer indicators on each
      half. Connection and output indicators remain on the left half only.
      This mode is mutually exclusive with ZMK Studio.

config ZMK_SPLIT
    default y

config BT_CTLR
    default BT

config ZMK_KSCAN_MATRIX_WAIT_BETWEEN_OUTPUTS
    default 5

config PINCTRL
    default y

if USB

config USB_NRFX
    default y

config USB_DEVICE_STACK
    default y

endif # USB

if ZMK_BACKLIGHT

config PWM
    default y

config LED_PWM
    default y

endif # ZMK_BACKLIGHT

if ZMK_RGB_UNDERGLOW

config SPI
    default y

config WS2812_STRIP
    default y

endif # ZMK_RGB_UNDERGLOW

endif # BOARD_GLOVE80_LH || BOARD_GLOVE80_RH
```

## app/dts/bindings/behaviors/zmk,behavior-hold-tap-bilateral.yaml
```yaml
# Copyright (c) 2026 The ZMK Contributors
# SPDX-License-Identifier: MIT

description: Bilaterally enforced Hold or Tap behavior

compatible: "zmk,behavior-hold-tap-bilateral"

include: hold-tap-base.yaml
```

## app/dts/bindings/behaviors/zmk,behavior-hold-tap.yaml
```yaml
# Copyright (c) 2020 The ZMK Contributors
# SPDX-License-Identifier: MIT

description: Hold or Tap behavior

compatible: "zmk,behavior-hold-tap"

include: hold-tap-base.yaml
```

## app/dts/bindings/behaviors/zmk,behavior-rgb-status.yaml
```yaml
# Copyright (c) 2026 The ZMK Contributors
# SPDX-License-Identifier: MIT

description: RGB status indicator behavior

compatible: "zmk,behavior-rgb-status"

include: zero_param.yaml
```

## app/dts/bindings/zmk,underglow-indicators.yaml
```yaml
# Copyright (c) 2020, The ZMK Contributors
# SPDX-License-Identifier: MIT

description: Underglow indicators

compatible: "zmk,underglow-indicators"

properties:
  bat-lhs:
    type: array
  bat-rhs:
    type: array
  bat-local:
    type: array
  capslock:
    type: int
    required: true
  numlock:
    type: int
    required: true
  scrolllock:
    type: int
    required: true
  layer-state:
    type: array
    required: true
  layer-ids:
    type: array
  ble-state:
    type: array
  usb-state:
    type: int
  output-fallback:
    type: int
```
