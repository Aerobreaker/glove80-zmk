#include "../behavior_keymap.dtsi"

&lht {
    hold-trigger-key-positions = <2>;
};

&kscan {
    events = <
        ZMK_MOCK_PRESS(0, 0, 20)
        ZMK_MOCK_PRESS(1, 0, 250)
        ZMK_MOCK_RELEASE(1, 0, 250)
        ZMK_MOCK_RELEASE(0, 0, 200)
        ZMK_MOCK_PRESS(1, 0, 200)
        ZMK_MOCK_RELEASE(1, 0, 10)
    >;
};
