#include "../behavior_keymap.dtsi"

&kscan {
    events = <
        ZMK_MOCK_PRESS(0, 0, 250)
        ZMK_MOCK_RELEASE(0, 0, 100)
        ZMK_MOCK_PRESS(0, 0, 250)
        ZMK_MOCK_RELEASE(0, 0, 200)
        ZMK_MOCK_PRESS(1, 0, 10)
        ZMK_MOCK_RELEASE(1, 0, 10)
    >;
};
